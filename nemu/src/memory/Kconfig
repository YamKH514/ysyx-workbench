## nemu/src/memory/Kconfig
```kconfig
menu "Memory Configuration"

config MBASE
  hex "Memory base address"
  default 0x0        if ISA_x86
  default 0x80000000

config MSIZE
  hex "Memory size"
  default 0x8000000

config SRAMBASE
  depends on YSYXSOC || SOC_BIN
  hex "ysyxSoC SRAM base address"
  default 0x0f000000

config SRAMSIZE
  depends on YSYXSOC || SOC_BIN
  hex "ysyxSoC SRAM size"
  default 0x2000

config PSRAMBASE
  depends on YSYXSOC || SOC_BIN
  hex "ysyxSoC PSRAM base address"
  default 0x80000000

config PSRAMSIZE
  depends on YSYXSOC || SOC_BIN
  hex "ysyxSoC PSRAM size"
  default 0x400000

config SDRAMBASE
  depends on YSYXSOC || SOC_BIN
  hex "SDRAM base address"
  default 0xa0000000

config SDRAMSIZE
  depends on YSYXSOC || SOC_BIN
  hex "SDRAM size"
  default 0x2000000

config PC_RESET_OFFSET
  hex "Offset of reset vector from the base of memory"
  default 0x100000 if ISA_x86
  default 0

choice
  prompt "Physical memory definition"
  default PMEM_GARRAY
config PMEM_MALLOC
  bool "Using malloc()"
config PMEM_GARRAY
  depends on !TARGET_AM
  bool "Using global array"
endchoice

config MEM_RANDOM
  depends on MODE_SYSTEM && !DIFFTEST && !TARGET_AM
  bool "Initialize the memory with random values"
  default y
  help
    This may help to find undefined behaviors.

endmenu #MEMORY
```

## npc/Kconfig
```kconfig
mainmenu "NPC Configuration Menu"

menu "Testing and Debugging"

config BATCH_MODE
  bool "Run with batch mode"
  default n

config WATCHPOINT
  bool "Enable watchpoint"
  default n

config TRACE
  bool "Enable tracer"
  default y

config TRACE_START
  depends on TRACE
  int "When tracing is enabled (unit: number of instructions)"
  default 0

config TRACE_END
  depends on TRACE
  int "When tracing is disabled (unit: number of instructions)"
  default 10000

config VCD_TRACE
  depends on TRACE
  bool "Enable VCD wive tracer"
  default y

config ITRACE
  depends on TRACE
  bool "Enable instruction tracer"
  default y

config ITRACE_COND
  depends on ITRACE
  string "Only trace instructions when the condition is true"
  default "true"

config MTRACE
  depends on TRACE
  bool "Enable memory tracer"
  default n

config FTRACE
  depends on TRACE
  bool "Enable func tracer"
  default n

config DIFFTEST
  bool "Enable differential testing"
  default n
  help
    Enable differential testing with a reference design.
    Note that this will significantly reduce the performance of NPC.

endmenu

source "csrc/memory/Kconfig"
```

## npc/csrc/memory/Kconfig
```kconfig
menu "Memory Configuration"

config MBASE
  hex "Memory base address"
  default 0x30000000

config MSIZE
  hex "Memory size"
  default 0x1000000

config SRAMBASE
  hex "SRAM base address"
  default 0x0f000000

config SRAMSIZE
  hex "SRAM size"
  default 0x2000

config PSRAMBASE
  hex "PSRAM base address"
  default 0x80000000

config PSRAMSIZE
  hex "PSRAM size"
  default 0x400000

config SDRAMBASE
  hex "SDRAM base address"
  default 0xa0000000

config SDRAMSIZE
  hex "SDRAM size"
  default 0x2000000

endmenu
```
